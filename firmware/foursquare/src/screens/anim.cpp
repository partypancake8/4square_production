// anim.cpp, frame data and the pure renderer for the DOWN page.
//
// The bitmaps are carried over verbatim from the old breadboard 2x2 clock
// (~/flowclock/oled2x2x-ref/justclockc3). Generated by the Wokwi animator,
// artwork by icons8. 48x48 at 288 bytes a frame, 111 frames, ~32 KB of flash
// against ~900 KB free, the size objection people expect here does not apply.
//
// ===========================================================================
// WHY THE FRAME TABLES ARE UNSIZED, AND WHY EACH ONE IS static_assert-ED
// ===========================================================================
// heartFrames used to be declared
//
//     #define HEART_FRAME_COUNT 28
//     static const uint8_t PROGMEM heartFrames[HEART_FRAME_COUNT][288] = { ... };
//
// with TWENTY-SEVEN initialisers in the braces. That is not an error in C++  - 
// it is a defined, silent zero-fill. heartFrames[27] became 288 bytes of zeros,
// anim_count(AN_HEART) went on returning 28, and anim_draw's `tick % n` reached
// it once per cycle. Every 28 frames, which at ANIM_FRAME_MS = 125 is every
// 3.5 seconds, the heart rendered as NOTHING and came back the next frame. The
// user reported it as "sometimes skips a frame". It was.
//
// Changing 28 to 27 would fix that one instance and leave the mechanism intact.
// So instead:
//
//   1. The first extent is EMPTY. The compiler counts the initialisers; there
//      is no second number for them to disagree with.
//   2. The count is DERIVED, sizeof(x)/sizeof(x[0]), never typed.
//   3. A static_assert PINS it. Adding or dropping a frame is now a compile
//      error that says so, rather than a blank frame nobody sees for a month.
//
// And a fourth lock lives outside this file: tools/layoutcheck renders every
// tick of every animation and fails on any frame that lights zero pixels,
// unless anim_blank_ok() declares that the animation wants one. Its selftest
// plants a blanked heart frame and must catch it.
#include "anim.h"
#include "faces.h"
#include "display.h"

#define HEART_W 48
#define HEART_H 48
static const uint8_t PROGMEM heartFrames[][288] = {
  {0,0,0,0,0,0,0,0,0,0,0,0,0,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0,0},
  {0,0,0,0,0,0,0,0,0,0,0,0,0,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0,0},
  {0,0,0,0,0,0,0,0,0,0,0,0,0,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0,0},
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  {0,0,0,0,0,0,0,0,0,0,0,0,0,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0,0}
};

// THE HEART IS 27 FRAMES AND ALWAYS WAS. The data is a coherent beat: four
// held frames of the resting outline (283 lit px), a small dip (251, 264) as
// it draws breath, a swell over three frames to the filled peak (734, 1299,
// 1311, 1296, 1275), a held systole (1234 for six frames), the second louder
// beat (1391, 1491), then the decay back through 1292, 1117, 705, 373, 287 to
// 283, which is the number the cycle STARTED on. The loop is continuous: the
// change in lit pixels across the wrap is 0, against a mid-cycle maximum of
// 565. There was never a 28th frame to find; there was a 28 in a declaration.
static constexpr uint8_t HEART_FRAME_COUNT =
    (uint8_t)(sizeof heartFrames / sizeof heartFrames[0]);
static_assert(HEART_FRAME_COUNT == 27,
              "heartFrames changed length. This assert is the whole point: the "
              "count used to be a #define that disagreed with the initialisers "
              "and the difference rendered as a blank frame every 3.5 s. If you "
              "meant to add or remove a beat, update the number here AND check "
              "the lit-pixel curve is still continuous across the wrap.");

// ── eye blink frames (48x48, 28 frames, column-major) ────────────────────────
#define EYE_W 48
#define EYE_H 48
static const uint8_t PROGMEM eyeFrames[][288] = {
  {0,0,0,0,0,0,0,0,0,0,0,0,0,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0,0},
  {0,0,0,0,0,0,0,0,0,0,0,0,0,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0,0},
  {0,0,0,0,0,0,0,0,0,0,0,0,0,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0,0},
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  {0,0,0,0,0,0,0,0,0,0,0,0,0,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0,0}
};

static constexpr uint8_t EYE_FRAME_COUNT =
    (uint8_t)(sizeof eyeFrames / sizeof eyeFrames[0]);
static_assert(EYE_FRAME_COUNT == 28, "eyeFrames changed length, see the note "
                                     "above heartFrames before editing this.");

// -- fidget spinner frames (48x48, 28 frames) --
#define FIDGET_W 48
#define FIDGET_H 48
static const uint8_t PROGMEM fidgetFrames[][288] = {
  {0,0,0,0,0,0,0,0,0,0,0,0,0,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0,0},
  {0,0,0,0,0,0,0,0,0,0,0,0,0,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0,0},
  {0,0,0,0,0,0,0,0,0,0,0,0,0,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0,0},
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  {0,0,0,0,0,0,0,0,0,0,0,0,0,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0,0}
};

static constexpr uint8_t FIDGET_FRAME_COUNT =
    (uint8_t)(sizeof fidgetFrames / sizeof fidgetFrames[0]);
static_assert(FIDGET_FRAME_COUNT == 28, "fidgetFrames changed length, see the "
                                        "note above heartFrames first.");

// -- walking figure frames (48x48, 28 frames) --
#define WALK_W 48
#define WALK_H 48
static const uint8_t PROGMEM walkFrames[][288] = {
  {0,0,0,0,0,0,0,0,0,0,0,0,0,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0,0},
  {0,0,0,0,0,0,0,0,0,0,0,0,0,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0,0},
  {0,0,0,0,0,0,0,0,0,0,0,0,0,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0,0},
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  {0,0,0,0,0,0,0,0,0,0,0,0,0,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0,0}
};

static constexpr uint8_t WALK_FRAME_COUNT =
    (uint8_t)(sizeof walkFrames / sizeof walkFrames[0]);
static_assert(WALK_FRAME_COUNT == 28, "walkFrames changed length, see the note "
                                      "above heartFrames first.");

// ===========================================================================
// THE DRAWING KIT, SAFE-AREA-CLIPPED PRIMITIVES
// ===========================================================================
// Every procedural animation below composes out of these and NOTHING else.
// That is deliberate. The safe area is x[6..121] y[6..57]; ink outside it is
// invisible on the bench and clipped on the glass once the anti-burn-in wander
// reaches an extreme, so it is the class of bug that ships. Adafruit's own
// drawLine/drawCircle clip to the CANVAS (128x64), which is sixteen columns and
// twelve rows too generous.
//
// So px() is the only thing in this file that reaches c.drawPixel(), and it
// refuses anything outside the safe area. Every shape is rasterised through it.
// The geometry below is also DESIGNED to fit, the clip is a backstop against a
// rounding error in the integer trig, not a substitute for doing the sums, but
// with the backstop in place a one-pixel arithmetic slip is a cosmetic nick
// instead of a prover failure the day the case is on.

static inline void px(GFXcanvas1 &c, int16_t x, int16_t y) {
  if (x < SAFE_X0 || x > SAFE_X1 || y < SAFE_Y0 || y > SAFE_Y1) return;
  c.drawPixel(x, y, 1);
}

static void ahline(GFXcanvas1 &c, int16_t xa, int16_t xb, int16_t y) {
  if (xb < xa) { int16_t t = xa; xa = xb; xb = t; }
  for (int16_t x = xa; x <= xb; x++) px(c, x, y);
}
static void avline(GFXcanvas1 &c, int16_t x, int16_t ya, int16_t yb) {
  if (yb < ya) { int16_t t = ya; ya = yb; yb = t; }
  for (int16_t y = ya; y <= yb; y++) px(c, x, y);
}

// Bresenham, through px(). Short lines only, the longest here is a 44 px
// metronome arm, so the branchless variants are not worth the reading cost.
static void aline(GFXcanvas1 &c, int16_t x0, int16_t y0, int16_t x1, int16_t y1) {
  int16_t dx = (int16_t)(x1 - x0); if (dx < 0) dx = (int16_t)-dx;
  int16_t dy = (int16_t)(y1 - y0); if (dy < 0) dy = (int16_t)-dy;
  const int16_t sx = x0 < x1 ? 1 : -1;
  const int16_t sy = y0 < y1 ? 1 : -1;
  int16_t err = (int16_t)(dx - dy);
  for (;;) {
    px(c, x0, y0);
    if (x0 == x1 && y0 == y1) break;
    const int16_t e2 = (int16_t)(2 * err);
    if (e2 > -dy) { err = (int16_t)(err - dy); x0 = (int16_t)(x0 + sx); }
    if (e2 <  dx) { err = (int16_t)(err + dx); y0 = (int16_t)(y0 + sy); }
  }
}

// Midpoint circle, eight-way symmetric, through px().
static void acircle(GFXcanvas1 &c, int16_t cx, int16_t cy, int16_t r) {
  if (r <= 0) { px(c, cx, cy); return; }
  int16_t x = r, y = 0, err = (int16_t)(1 - r);
  while (x >= y) {
    px(c, (int16_t)(cx + x), (int16_t)(cy + y));
    px(c, (int16_t)(cx + y), (int16_t)(cy + x));
    px(c, (int16_t)(cx - y), (int16_t)(cy + x));
    px(c, (int16_t)(cx - x), (int16_t)(cy + y));
    px(c, (int16_t)(cx - x), (int16_t)(cy - y));
    px(c, (int16_t)(cx - y), (int16_t)(cy - x));
    px(c, (int16_t)(cx + y), (int16_t)(cy - x));
    px(c, (int16_t)(cx + x), (int16_t)(cy - y));
    y++;
    if (err < 0) err = (int16_t)(err + 2 * y + 1);
    else { x--; err = (int16_t)(err + 2 * (y - x) + 1); }
  }
}

// floor(sqrt(v)) for v >= 0, by the digit-by-digit binary method.
//
// THE SEED MUST BE A POWER OF FOUR. It was 1<<15 here for one build, and 2^15
// has an ODD exponent, shifting it down by two never reaches 1, so every
// remainder was taken against the wrong place value and every root came back
// wrong. It did not look wrong: the ellipses were still ellipses, just the
// wrong size, and the bouncing ball grew until it touched its own floor. The
// prover found it as an OVERLAP between two elements that are separated by a
// pixel on paper, which is exactly the kind of arithmetic slip nothing else
// here would have caught. 1<<30 is 4^15, and covers the whole positive int32.
static int16_t aisqrt(int32_t v) {
  if (v <= 0) return 0;
  int32_t r = 0, b = 1L << 30;
  while (b > v) b >>= 2;
  while (b) {
    if (v >= r + b) { v -= r + b; r = (r >> 1) + b; }
    else r >>= 1;
    b >>= 2;
  }
  return (int16_t)r;
}

// A filled disc, scanline. Kept small everywhere it is used, a disc is the
// most expensive shape in the fill budget and this file leans on outlines.
static void adisc(GFXcanvas1 &c, int16_t cx, int16_t cy, int16_t r) {
  if (r <= 0) { px(c, cx, cy); return; }
  for (int16_t dy = (int16_t)-r; dy <= r; dy++) {
    const int16_t w = aisqrt((int32_t)r * r - (int32_t)dy * dy);
    ahline(c, (int16_t)(cx - w), (int16_t)(cx + w), (int16_t)(cy + dy));
  }
}

// An ELLIPSE OUTLINE, sampled on BOTH axes and unioned. Sampling only x leaves
// the near-vertical sides as isolated dots; sampling only y does the same to a
// flat top. The union is connected for any aspect ratio, which matters because
// the eyes below squash from 16x9 to 16x1 as a lid closes.
static void aellipse(GFXcanvas1 &c, int16_t cx, int16_t cy, int16_t a, int16_t b) {
  if (a <= 0 || b <= 0) { ahline(c, (int16_t)(cx - a), (int16_t)(cx + a), cy); return; }
  for (int16_t dx = (int16_t)-a; dx <= a; dx++) {
    const int32_t t = (int32_t)b * b * ((int32_t)a * a - (int32_t)dx * dx);
    const int16_t dy = (int16_t)(aisqrt(t) / a);
    px(c, (int16_t)(cx + dx), (int16_t)(cy + dy));
    px(c, (int16_t)(cx + dx), (int16_t)(cy - dy));
  }
  for (int16_t dy = (int16_t)-b; dy <= b; dy++) {
    const int32_t t = (int32_t)a * a * ((int32_t)b * b - (int32_t)dy * dy);
    const int16_t dx = (int16_t)(aisqrt(t) / b);
    px(c, (int16_t)(cx + dx), (int16_t)(cy + dy));
    px(c, (int16_t)(cx - dx), (int16_t)(cy + dy));
  }
}

static void afill(GFXcanvas1 &c, int16_t x, int16_t y, int16_t w, int16_t h) {
  for (int16_t j = 0; j < h; j++)
    ahline(c, x, (int16_t)(x + w - 1), (int16_t)(y + j));
}

// ---- integer trig -----------------------------------------------------------
// ONE TURN IS 64 STEPS and sine is scaled by 1024, so every position below is
// (radius * SIN(step)) >> 10 with no floating point anywhere. 64 steps is 5.6
// degrees, which at the radii used here (<= 25 px) moves a point by at most
// 2.5 px, smooth enough at 8 fps, and it makes every period a divisor or
// multiple of 64, which is what lets anim_cycle() state an EXACT repeat.
static const int16_t SIN64[64] = {
      0,   100,   200,   297,   392,   483,   569,   650,
    724,   792,   851,   903,   946,   980,  1004,  1019,
   1024,  1019,  1004,   980,   946,   903,   851,   792,
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   -724,  -650,  -569,  -483,  -392,  -297,  -200,  -100,
};
static inline int16_t SN(int16_t step) { return SIN64[(uint8_t)(step & 63)]; }
static inline int16_t CS(int16_t step) { return SIN64[(uint8_t)((step + 16) & 63)]; }
// radius * sin(step), rounded toward zero. int32 in the middle because
// 25 * 1024 already overflows nothing but 1024 * 1024 would.
static inline int16_t RSIN(int16_t r, int16_t step) {
  return (int16_t)(((int32_t)r * SN(step)) / 1024);
}
static inline int16_t RCOS(int16_t r, int16_t step) {
  return (int16_t)(((int32_t)r * CS(step)) / 1024);
}

// The middle of the safe area. Everything radial is built about this point.
static const int16_t ACX = (int16_t)(SAFE_X0 + SAFE_W / 2);   // 64
static const int16_t ACY = (int16_t)(SAFE_Y0 + SAFE_H / 2);   // 32

// ===========================================================================
// THE PROCEDURAL ANIMATIONS
// ===========================================================================
// Each is a pure function of the tick. No millis(), no statics that carry state
// between calls, no I2C, anim_draw() is enumerable, and that is the property
// the whole prover rests on.
//
// FILL BUDGET. Lit pixels are a burn-in budget (tools/layoutcheck holds screens
// to 15% of 8192 px = 1229 lit). Animations are measured but not gated there,
// because a frame that is up for 125 ms is not what an always-on duty metric is
// about, which makes it easy to be careless, so these are drawn as outlines,
// dots and hatches on purpose and every one of them measures well under the
// line anyway.

// ---- AN_EYES, four eyes, four PRIME blink periods -------------------------
// The charm is that they are out of sync, so the periods are chosen to make
// synchronising impossible rather than unlikely: 17, 23, 29 and 37 are prime,
// so all four can only align once every 17*23*29*37 = 419,543 frames, which at
// 8 fps is 14 hours 34 minutes. Pairwise, the slowest coincidence is 29*37 =
// 1073 frames, two and a quarter minutes. Nothing about the pattern repeats on
// a timescale anybody watches.
//
// The offsets stop them all blinking together at tick 0, which is the one
// moment a common period would not have prevented, ui.cpp zeroes anim_tick
// every time the animation page is entered, so tick 0 is a frame the user sees
// EVERY time, not a theoretical one.
//
// A BLINK IS FIVE FRAMES, NOT ONE. Half-lidded, nearly shut, fully shut,
// nearly shut, half-lidded, 625 ms, which reads as a blink. A one-frame
// disappearance would read as the heart bug this file was opened to fix.
struct EyeSpec { int16_t cx, cy; uint8_t period, phase; };
static const EyeSpec EYES4[4] = {
  { 35, 19, 17,  0 },
  { 93, 19, 23,  5 },
  { 35, 45, 29, 11 },
  { 93, 45, 37,  3 },
};
static const int16_t EYE_A = 16;    // half-width;  35-16=19 .. 93+16=109
static const int16_t EYE_B =  9;    // half-height; 19-9=10  .. 45+9=54
static const int16_t LID[5] = { 6, 3, 0, 3, 6 };   // half-height while blinking

static void draw_eyes4(GFXcanvas1 &c, uint16_t tick) {
  for (uint8_t i = 0; i < 4; i++) {
    const EyeSpec &e = EYES4[i];
    // Each eye is its OWN element. They are disjoint by construction, the
    // columns are 19..51 against 77..109 and the rows 10..28 against 36..54  - 
    // so the prover gets to police that separation rather than take it on
    // trust, and a future eye that grows into its neighbour is a failure.
    static const char *NAMES[4] = { "eye-tl", "eye-tr", "eye-bl", "eye-br" };
    ELEM(NAMES[i]);

    const uint8_t p = (uint8_t)((tick + e.phase) % e.period);
    const int16_t b = (p < 5) ? LID[p] : EYE_B;

    if (b <= 0) {
      // Shut. A lid line with two lashes, so a closed eye is unmistakably a
      // closed eye and never an empty panel.
      ahline(c, (int16_t)(e.cx - EYE_A), (int16_t)(e.cx + EYE_A), e.cy);
      px(c, (int16_t)(e.cx - EYE_A - 0), (int16_t)(e.cy - 1));
      px(c, (int16_t)(e.cx + EYE_A - 0), (int16_t)(e.cy - 1));
      continue;
    }

    aellipse(c, e.cx, e.cy, EYE_A, b);

    // A slow gaze wander, one per eye, on yet another period so the eyes do
    // not even look in the same direction. Bounded at +/-7 against a 16 px
    // half-width, so the pupil never reaches the lid.
    const int16_t gx = RSIN(7, (int16_t)((tick + i * 13) & 63));
    const int16_t rp = (b >= 7) ? 4 : (b >= 4 ? 2 : 1);
    adisc(c, (int16_t)(e.cx + gx), e.cy, rp);
  }
}

// ---- AN_ORBIT --------------------------------------------------------------
static void draw_orbit(GFXcanvas1 &c, uint16_t tick) {
  ELEM("orbit");
  static const int16_t R[3]  = { 10, 16, 22 };
  static const int16_t SP[3] = {  3, -2,  1 };
  static const int16_t PH[3] = {  0, 21, 42 };
  // THE TRACKS ARE DRAWN, NOT DOTTED. Dotting them to save ink was the first
  // attempt and it read as a scatter of dots with three more dots moving in
  // it, the orbits have to be visible as PATHS or the movement has nothing to
  // be movement along. Three outlines cost about 300 px, which is 3.7%.
  for (uint8_t k = 0; k < 3; k++) acircle(c, ACX, ACY, R[k]);
  for (uint8_t k = 0; k < 3; k++) {
    const int16_t a = (int16_t)((int16_t)tick * SP[k] + PH[k]);
    adisc(c, (int16_t)(ACX + RSIN(R[k], a)), (int16_t)(ACY + RCOS(R[k], a)), 2);
  }
  adisc(c, ACX, ACY, 3);
}

// ---- AN_SWING, a pendulum -------------------------------------------------
static void draw_swing(GFXcanvas1 &c, uint16_t tick) {
  ELEM("swing");
  const int16_t PY = (int16_t)(SAFE_Y0 + 2);          // pivot at y=8
  const int16_t L  = 38;
  const int16_t a  = RSIN(7, (int16_t)(tick * 2));    // +/-7 steps = +/-39 deg
  const int16_t bx = (int16_t)(ACX + RSIN(L, a));
  const int16_t by = (int16_t)(PY  + RCOS(L, a));
  adisc(c, ACX, PY, 2);
  aline(c, ACX, PY, bx, by);
  acircle(c, bx, by, 5);
  px(c, bx, by);
}

// ---- AN_BALL, bounce with squash ------------------------------------------
static void draw_ball(GFXcanvas1 &c, uint16_t tick) {
  // THE FLOOR IS THE LAST SAFE ROW and the ball rests TWO rows above it, so
  // there is a clear row between them. A ball at rest genuinely touches its
  // floor, but two elements with no gap read as one shape to the prover's
  // crowding check and to the eye at this size, and the anti-burn-in wander
  // moves them together, so the gap never closes.
  const int16_t FLOOR = SAFE_Y1;                     // 57
  ELEM("floor");
  for (int16_t x = (int16_t)(SAFE_X0 + 4); x <= SAFE_X1 - 4; x += 3)
    px(c, x, FLOOR);

  ELEM("ball");
  const int16_t u = (int16_t)(tick % 22);
  const int16_t v = (int16_t)(u - 11);
  const int16_t h = (int16_t)(30 - (30 * v * v) / 121);   // 0 .. 30
  const bool    squash = h <= 2;
  const int16_t rx = squash ? 10 : 7;
  const int16_t ry = squash ?  5 : 7;
  const int16_t p  = (int16_t)(tick % 44);
  const int16_t bx = (int16_t)(20 + (p < 22 ? p * 4 : (44 - p) * 4));
  const int16_t by = (int16_t)(FLOOR - 2 - ry - h);
  aellipse(c, bx, by, rx, ry);
  // A highlight, offset the way the light would be. One pixel, and it is what
  // stops a squashing outline reading as a wobbling ring.
  px(c, (int16_t)(bx - rx / 2), (int16_t)(by - ry / 2));
}

// ---- AN_WAVE ---------------------------------------------------------------
static void draw_wave(GFXcanvas1 &c, uint16_t tick) {
  ELEM("wave");
  int16_t prev = 0;
  bool have = false;
  for (int16_t x = SAFE_X0; x <= SAFE_X1; x++) {
    const int16_t y = (int16_t)(ACY + RSIN(18, (int16_t)(x * 2 + tick * 3)));
    if (have) avline(c, x, prev, y); else px(c, x, y);
    prev = y; have = true;
  }
  // A dashed axis, so the amplitude has something to be an amplitude of.
  for (int16_t x = SAFE_X0; x <= SAFE_X1; x += 6) px(c, x, ACY);
}

// ---- AN_RIPPLE -------------------------------------------------------------
static void draw_ripple(GFXcanvas1 &c, uint16_t tick) {
  ELEM("ripple");
  for (uint8_t k = 0; k < 3; k++) {
    const int16_t r = (int16_t)((tick + k * 8) % 24 + 2);
    acircle(c, ACX, ACY, r);
  }
  px(c, ACX, ACY);
}

// ---- AN_CUBE, rotating wireframe ------------------------------------------
// PERSPECTIVE IS NOT DECORATION HERE, IT IS THE WHOLE READING. Orthographic,
// spun about Y and tilted about X, a cube's eight vertices project to two
// columns of four, the near and far faces land exactly on top of each other
// and the twelve edges draw a LADDER. That is what the first version of this
// looked like, and it did not read as a cube from any angle. Dividing by depth
// makes the near face bigger than the far one, which is the only cue an
// unshaded wireframe has.
static void draw_cube(GFXcanvas1 &c, uint16_t tick) {
  ELEM("cube");
  const int16_t S = 10;                      // half-edge
  const int16_t D = 58;                      // eye distance, in the same units
  // A slow tumble on top of the spin, so it is never edge-on for long. Both
  // terms are whole steps of the 64-step turn, which keeps the period at 64.
  const int16_t B = (int16_t)(6 + RSIN(3, (int16_t)tick));
  int16_t vx[8], vy[8];
  for (uint8_t i = 0; i < 8; i++) {
    const int16_t x = (i & 1) ? S : (int16_t)-S;
    const int16_t y = (i & 2) ? S : (int16_t)-S;
    const int16_t z = (i & 4) ? S : (int16_t)-S;
    const int16_t a = (int16_t)tick;
    const int16_t x1 = (int16_t)(((int32_t)x * CS(a) - (int32_t)z * SN(a)) / 1024);
    const int16_t z1 = (int16_t)(((int32_t)x * SN(a) + (int32_t)z * CS(a)) / 1024);
    const int16_t y2 = (int16_t)(((int32_t)y * CS(B) - (int32_t)z1 * SN(B)) / 1024);
    const int16_t z2 = (int16_t)(((int32_t)y * SN(B) + (int32_t)z1 * CS(B)) / 1024);
    const int32_t den = (int32_t)D + z2;     // D=58, |z2| <= 17, never zero
    vx[i] = (int16_t)(ACX + (int16_t)(((int32_t)x1 * D) / den));
    vy[i] = (int16_t)(ACY + (int16_t)(((int32_t)y2 * D) / den));
  }
  // The twelve edges are the vertex pairs differing in exactly one bit.
  for (uint8_t i = 0; i < 8; i++)
    for (uint8_t b = 1; b < 8; b <<= 1)
      if (!(i & b)) aline(c, vx[i], vy[i], vx[i | b], vy[i | b]);
}

// ---- AN_SPIRAL -------------------------------------------------------------
// ONE TURN, ONE CONNECTED ARM. Stepping the angle by 5 of the 64 gave five
// laps of scattered dots, which reads as confetti: a spiral is only legible if
// consecutive samples are JOINED and the arm makes about one revolution.
static void draw_spiral(GFXcanvas1 &c, uint16_t tick) {
  ELEM("spiral");
  int16_t lx = 0, ly = 0;
  bool have = false;
  for (int16_t i = 0; i < 64; i++) {
    const int16_t a = (int16_t)(i + tick * 2);
    const int16_t r = (int16_t)((i * 25) / 64);
    const int16_t x = (int16_t)(ACX + RSIN(r, a));
    const int16_t y = (int16_t)(ACY + RCOS(r, a));
    if (have) aline(c, lx, ly, x, y); else px(c, x, y);
    lx = x; ly = y; have = true;
  }
  adisc(c, ACX, ACY, 1);
}

// ---- AN_STARS --------------------------------------------------------------
// THE POSITIONS COME FROM A TABLE, NOT FROM ARITHMETIC ON THE INDEX. i*7 mod
// 52 against i*13 mod 110 is two arithmetic progressions, and two arithmetic
// progressions plotted against each other are a DIAGONAL LINE, which is what
// the first version drew. Thirty bytes of scatter is cheaper than a hash and
// it is the only version that looks like a sky.
static const uint8_t STAR_X[30] = {
   30,  38,  13,  92,  50,  61,  19,  11,   8,   2,
   51,  70,  37, 102,  97,   7,  28,  66,  68,  46,
   35,  99,  22, 105,  13,  33,  27,   3, 106,  82,
};
static const uint8_t STAR_Y[30] = {
   51,  16,  51,  17,  12,  10,  19,  18,  40,  46,
   23,   5,  38,  21,  42,  24,  32,  15,  11,  15,
   30,  17,   5,  35,  19,   0,  18,  36,  45,  19,
};
static void draw_stars(GFXcanvas1 &c, uint16_t tick) {
  ELEM("stars");
  for (int16_t i = 0; i < 30; i++) {
    const int16_t sp = (int16_t)(1 + (i % 3));
    const int16_t y  = (int16_t)(SAFE_Y0 + (STAR_Y[i] % SAFE_H));
    const int16_t x  = (int16_t)(SAFE_X1 - ((STAR_X[i] + (int16_t)tick * sp) % SAFE_W));
    px(c, x, y);
    // A trail on the fast ones only. Drawn to the RIGHT, i.e. behind, and only
    // where it fits, a trail the clip would eat is ink that is not there.
    if (sp == 3 && x <= SAFE_X1 - 2) { px(c, (int16_t)(x + 1), y);
                                       px(c, (int16_t)(x + 2), y); }
  }
}

// ---- AN_METRO, a metronome ------------------------------------------------
static void draw_metro(GFXcanvas1 &c, uint16_t tick) {
  ELEM("metro");
  const int16_t PY = (int16_t)(SAFE_Y1 - 3);          // pivot at y=54
  const int16_t L  = 40;
  const int16_t a  = RSIN(6, (int16_t)(tick * 2));    // +/-6 steps = +/-34 deg
  const int16_t tx = (int16_t)(ACX + RSIN(L, a));
  const int16_t ty = (int16_t)(PY  - RCOS(L, a));
  // The plinth.
  ahline(c, (int16_t)(ACX - 16), (int16_t)(ACX + 16), (int16_t)(PY + 3));
  ahline(c, (int16_t)(ACX - 12), (int16_t)(ACX + 12), (int16_t)(PY + 2));
  avline(c, (int16_t)(ACX - 12), (int16_t)(PY + 1), (int16_t)(PY + 3));
  avline(c, (int16_t)(ACX + 12), (int16_t)(PY + 1), (int16_t)(PY + 3));
  // The scale the arm swings across: five marks at the ends and thirds.
  for (int16_t k = -6; k <= 6; k += 3)
    px(c, (int16_t)(ACX + RSIN(44, k)), (int16_t)(PY - RCOS(44, k)));
  // The arm and its weight, the weight riding at 55% of the arm.
  aline(c, ACX, PY, tx, ty);
  const int16_t wx = (int16_t)(ACX + RSIN((int16_t)(L * 55 / 100), a));
  const int16_t wy = (int16_t)(PY  - RCOS((int16_t)(L * 55 / 100), a));
  afill(c, (int16_t)(wx - 3), (int16_t)(wy - 2), 7, 5);
  adisc(c, ACX, PY, 2);
}

// ---- AN_SAND, an hourglass ------------------------------------------------
// Hatched every other row rather than filled: a solid bulb of sand is 400 lit
// pixels of nothing, and the hatch reads as grains.
static void draw_sand(GFXcanvas1 &c, uint16_t tick) {
  ELEM("sand");
  const int16_t X0 = (int16_t)(ACX - 22), X1 = (int16_t)(ACX + 22);
  const int16_t TY = (int16_t)(SAFE_Y0 + 2);          // 8
  const int16_t BY = (int16_t)(SAFE_Y1 - 1);          // 56
  const int16_t NY = ACY;                             // the neck
  // The glass: two triangles nose to nose, plus the neck walls.
  ahline(c, X0, X1, TY);
  ahline(c, X0, X1, BY);
  aline(c, X0, TY, (int16_t)(ACX - 1), (int16_t)(NY - 1));
  aline(c, X1, TY, (int16_t)(ACX + 1), (int16_t)(NY - 1));
  aline(c, (int16_t)(ACX - 1), (int16_t)(NY + 1), X0, BY);
  aline(c, (int16_t)(ACX + 1), (int16_t)(NY + 1), X1, BY);

  const int16_t t = (int16_t)(tick % 48);
  // Top bulb: the sand sits at the BOTTOM of the cone and the level falls.
  const int16_t top_lv = (int16_t)(TY + 1 + (22 * t) / 48);
  for (int16_t y = top_lv; y < NY - 1; y += 2) {
    const int16_t hw = (int16_t)((22 * (NY - 1 - y)) / (NY - 1 - TY));
    ahline(c, (int16_t)(ACX - hw + 1), (int16_t)(ACX + hw - 1), y);
  }
  // Bottom bulb: a pile growing off the floor.
  const int16_t bot_lv = (int16_t)(BY - 1 - (22 * t) / 48);
  for (int16_t y = (int16_t)(BY - 1); y > bot_lv; y -= 2) {
    const int16_t hw = (int16_t)((22 * (y - NY - 1)) / (BY - NY - 1));
    ahline(c, (int16_t)(ACX - hw + 1), (int16_t)(ACX + hw - 1), y);
  }
  // The stream, dashed and moving, so the thing is visibly running.
  for (int16_t y = (int16_t)(NY + 1); y < bot_lv; y++)
    if (((y + t) & 1) == 0) px(c, ACX, y);
}

// ---- AN_LOAD, a twelve-spoke spinner --------------------------------------
static void draw_load(GFXcanvas1 &c, uint16_t tick) {
  ELEM("load");
  static const int16_t SPOKE[12] = { 0, 5, 11, 16, 21, 27, 32, 37, 43, 48, 53, 59 };
  const int16_t head = (int16_t)(tick % 12);
  for (int16_t k = 0; k < 12; k++) {
    const int16_t age = (int16_t)((head - k + 12) % 12);
    if (age >= 6) continue;                   // only the last six are alight
    const int16_t len = (int16_t)(12 - age * 2);
    const int16_t a   = SPOKE[k];
    aline(c, (int16_t)(ACX + RSIN((int16_t)(22 - len), a)),
             (int16_t)(ACY + RCOS((int16_t)(22 - len), a)),
             (int16_t)(ACX + RSIN(22, a)),
             (int16_t)(ACY + RCOS(22, a)));
  }
  acircle(c, ACX, ACY, 4);
}

// ---- AN_BREATHE ------------------------------------------------------------
static void draw_breathe(GFXcanvas1 &c, uint16_t tick) {
  ELEM("breath-ring");
  const int16_t r = (int16_t)(15 + RSIN(9, (int16_t)tick));   // 6 .. 24
  acircle(c, ACX, ACY, r);
  // A second, tighter ring on the way in and out gives the movement a body.
  if (r >= 10) acircle(c, ACX, ACY, (int16_t)(r - 4));
  ELEM("breath-core");
  adisc(c, ACX, ACY, 2);      // r >= 6 above, so the two never touch
}

// ---- AN_HELIX --------------------------------------------------------------
static void draw_helix(GFXcanvas1 &c, uint16_t tick) {
  ELEM("helix");
  int16_t pa = 0, pb = 0;
  bool have = false;
  for (int16_t x = SAFE_X0; x <= SAFE_X1; x++) {
    // ONE AND THREE QUARTER TURNS ACROSS THE PANEL. At x*3 it was five, and
    // five turns of two strands plus a rung every 8 px is not a helix, it is a
    // braid, 1000 lit pixels of one, which was also the worst fill in the set.
    const int16_t s  = RSIN(16, (int16_t)(x + tick * 2));
    const int16_t ya = (int16_t)(ACY + s);
    const int16_t yb = (int16_t)(ACY - s);
    if (have) { avline(c, x, pa, ya); avline(c, x, pb, yb); }
    else      { px(c, x, ya); px(c, x, yb); }
    pa = ya; pb = yb; have = true;
    if (((x - SAFE_X0 + (int16_t)tick) % 10) == 0) avline(c, x, ya, yb);
  }
}

// ---- AN_SNAKE --------------------------------------------------------------
// The path is the perimeter of a rectangle, walked at 2 px a frame. Written as
// arc-length -> point so the body is just the head's position at earlier times,
// which is what makes it a pure function of the tick.
static const int16_t SNK_X0 = 20, SNK_X1 = 108, SNK_Y0 = 14, SNK_Y1 = 50;
static const int16_t SNK_W = SNK_X1 - SNK_X0;          // 88
static const int16_t SNK_H = SNK_Y1 - SNK_Y0;          // 36
static const int16_t SNK_P = 2 * (SNK_W + SNK_H);      // 248

static void snake_at(int16_t s, int16_t *x, int16_t *y) {
  s = (int16_t)(((s % SNK_P) + SNK_P) % SNK_P);
  if (s < SNK_W)                 { *x = (int16_t)(SNK_X0 + s);              *y = SNK_Y0; }
  else if (s < SNK_W + SNK_H)    { *x = SNK_X1;   *y = (int16_t)(SNK_Y0 + (s - SNK_W)); }
  else if (s < 2 * SNK_W + SNK_H){ *x = (int16_t)(SNK_X1 - (s - SNK_W - SNK_H)); *y = SNK_Y1; }
  else                           { *x = SNK_X0;   *y = (int16_t)(SNK_Y1 - (s - 2 * SNK_W - SNK_H)); }
}

static void draw_snake(GFXcanvas1 &c, uint16_t tick) {
  ELEM("snake");
  const int16_t head = (int16_t)((tick * 2) % SNK_P);
  for (int16_t i = 15; i >= 0; i--) {
    int16_t x, y;
    snake_at((int16_t)(head - i * 4), &x, &y);
    if (i == 0) { adisc(c, x, y, 3); }          // the head, and it is bigger
    else        { adisc(c, x, y, (int16_t)(i < 6 ? 2 : 1)); }
  }
}

// ---- AN_RAIN ---------------------------------------------------------------
static void draw_rain(GFXcanvas1 &c, uint16_t tick) {
  ELEM("rain");
  for (int16_t i = 0; i < 22; i++) {
    const int16_t sp = (int16_t)(1 + (i % 3));
    const int16_t x  = (int16_t)(SAFE_X0 + 1 + ((i * 23) % (SAFE_W - 2)));
    const int16_t y  = (int16_t)(SAFE_Y0 + (((int16_t)tick * sp + (i * 17) % 48) % 48));
    avline(c, x, y, (int16_t)(y + 2));
  }
  ELEM("puddle");     // rows 6..55 above, so the pool at 57 cannot be touched
  for (int16_t x = (int16_t)(SAFE_X0 + 2); x <= SAFE_X1 - 2; x += 4)
    px(c, (int16_t)(x + (int16_t)(tick & 1)), SAFE_Y1);
}

// ---- AN_BARS, a segmented nine-channel equaliser --------------------------
// SEGMENTED, NOT SOLID. Nine solid bars at full tilt is 1080 lit pixels;
// stacking 5 px dashes every third row is a third of that and reads better  - 
// it is what a VU meter looks like.
static const int16_t BAR_N     = 9;
static const int16_t BAR_W     = 7;
static const int16_t BAR_PITCH = 12;
// Centred in whatever the safe area actually is, NOT in a typed number. Here
// SAFE_W is 116; in the sibling tree the calibration nudge takes it to 110,
// and a bar row laid out against the wrong width puts its last channel under
// the clip, where it is invisible on the bench and gone on the glass. Every
// extent in this file is derived from SAFE_*, never typed.
static const int16_t BAR_SPAN = BAR_N * BAR_PITCH - (BAR_PITCH - BAR_W);
static const int16_t BAR_X0   = (int16_t)(SAFE_X0 + (SAFE_W - BAR_SPAN) / 2);

static void draw_bars(GFXcanvas1 &c, uint16_t tick) {
  static const char *NAMES[9] = { "bar0", "bar1", "bar2", "bar3", "bar4",
                                  "bar5", "bar6", "bar7", "bar8" };
  const int16_t BASE = (int16_t)(SAFE_Y1 - 2);        // 55
  for (int16_t i = 0; i < BAR_N; i++) {
    // One element per channel. They occupy disjoint COLUMNS by construction,
    // which the prover then holds them to.
    ELEM(NAMES[i]);
    const int16_t x0 = (int16_t)(BAR_X0 + i * BAR_PITCH);
    const int16_t x1 = (int16_t)(x0 + BAR_W - 1);
    const int16_t sp = (int16_t)(2 + (i % 4));
    const int16_t n  = (int16_t)(2 + (13 * (1024 + SN((int16_t)(tick * sp + i * 9)))) / 2048);
    for (int16_t k = 0; k < n; k++)
      ahline(c, x0, x1, (int16_t)(BASE - 3 * k));
    ahline(c, x0, x1, (int16_t)(SAFE_Y1));            // the channel's baseline
  }
}

// ---------------------------------------------------------------- accessors --
// anim_count() keeps its old meaning for the bitmap animations, how many
// frames of artwork there are, and for the procedural ones returns the base
// period, so `tick % anim_count(id)` remains a sane thing for a caller to do.
// The counts come from sizeof, never from a literal; see the note at the top.
uint8_t anim_count(uint8_t id) {
  switch (id) {
    case AN_WALK:    return WALK_FRAME_COUNT;
    case AN_EYE:     return EYE_FRAME_COUNT;
    case AN_FIDGET:  return FIDGET_FRAME_COUNT;
    case AN_HEART:   return HEART_FRAME_COUNT;
    case AN_EYES:    return 37;    // the slowest eye
    case AN_ORBIT:   return 64;
    case AN_SWING:   return 32;
    case AN_BALL:    return 44;
    case AN_WAVE:    return 64;
    case AN_RIPPLE:  return 24;
    case AN_CUBE:    return 64;
    case AN_SPIRAL:  return 32;
    case AN_STARS:   return (uint8_t)SAFE_W;   // one full sweep of the panel
    case AN_METRO:   return 32;
    case AN_SAND:    return 48;
    case AN_LOAD:    return 12;
    case AN_BREATHE: return 64;
    // lcm(32, 10): the strands travel on 32 and the rungs step on 10, so the
    // drawing only repeats when both land together. Getting this wrong is not
    // cosmetic, anim_cycle_exact() claims it and the prover checks the claim
    // against the bitmaps, which is how the 32 that used to be here was found.
    case AN_HELIX:   return 160;
    case AN_SNAKE:   return 124;
    case AN_RAIN:    return 48;
    case AN_BARS:    return 64;
  }
  return 1;
}

// SHORT. These land on the glass in the reveal frame's value column, next to
// the word ANIMATION, and a name that has to be cut there is a name that is
// wrong here. Uppercase A-Z only, the fonts are empty outside 0x20-0x5A.
const char *anim_name(uint8_t id) {
  switch (id) {
    case AN_WALK:    return "WALK";
    case AN_EYE:     return "EYE";
    case AN_FIDGET:  return "SPIN";
    case AN_HEART:   return "HEART";
    case AN_EYES:    return "EYES";
    case AN_ORBIT:   return "ORBIT";
    case AN_SWING:   return "SWING";
    case AN_BALL:    return "BALL";
    case AN_WAVE:    return "WAVE";
    case AN_RIPPLE:  return "RIPPLE";
    case AN_CUBE:    return "CUBE";
    case AN_SPIRAL:  return "SPIRAL";
    case AN_STARS:   return "STARS";
    case AN_METRO:   return "METRO";
    case AN_SAND:    return "SAND";
    case AN_LOAD:    return "LOAD";
    case AN_BREATHE: return "BREATH";
    case AN_HELIX:   return "HELIX";
    case AN_SNAKE:   return "SNAKE";
    case AN_RAIN:    return "RAIN";
    case AN_BARS:    return "BARS";
  }
  return "?";
}

// SAFE_W REACHES anim_count() THROUGH AN_STARS, and anim_count() is a uint8_t
// for source compatibility. 110 fits; a future panel or a smaller shift
// envelope that pushed it past 255 would wrap silently, so it does not get to.
static_assert(SAFE_W <= 255, "SAFE_W no longer fits anim_count()'s uint8_t. "
                             "Widen the return type or give AN_STARS a period "
                             "that is not the panel width.");
static_assert(SNK_X0 >= SAFE_X0 + 3 && SNK_X1 <= SAFE_X1 - 3 &&
              SNK_Y0 >= SAFE_Y0 + 3 && SNK_Y1 <= SAFE_Y1 - 3,
              "the snake's circuit has left the safe area (its head is r=3).");

// ------------------------------------------------------- the showcase reel --
uint8_t anim_total() { return (uint8_t)AN_COUNT; }

// A PERMUTATION, ordered for contrast rather than by id: a big bitmap, then a
// radial line drawing, then a figure, then a grid, and round again. Playing
// enum order would give four bitmaps followed by seventeen line drawings, which
// is the same set and a worse reel. layoutcheck proves it is a permutation.
static const uint8_t REEL[AN_COUNT] = {
  AN_EYES,  AN_HEART,  AN_ORBIT,  AN_WALK,   AN_BARS,   AN_CUBE,   AN_BALL,
  AN_RIPPLE, AN_EYE,   AN_SPIRAL, AN_SWING,  AN_RAIN,   AN_FIDGET, AN_HELIX,
  AN_SNAKE, AN_WAVE,   AN_STARS,  AN_SAND,   AN_LOAD,   AN_METRO,  AN_BREATHE,
};
uint8_t anim_reel(uint8_t i) {
  return (i < AN_COUNT) ? REEL[i] : (uint8_t)AN_WALK;
}

static uint16_t gcd16(uint16_t a, uint16_t b) {
  while (b) { const uint16_t t = (uint16_t)(a % b); a = b; b = t; }
  return a;
}

uint16_t anim_cycle(uint8_t id) {
  switch (id) {
    // THE WALKER'S CYCLE IS NOT HIS FRAME COUNT. His pose runs on 28 frames and
    // his position ping-pongs over 2 * (SAFE_W - ANIM_W) = 124 at the safe area
    // this build has, so the drawing only repeats at lcm(28, 124) = 868 frames,
    // just under two minutes. A reel that showed him for 28 would show a
    // quarter of one leg of the pace. COMPUTED, not typed: SAFE_W is a
    // consequence of SHIFT_MAX and CAL_MAX_X and has moved once already.
    case AN_WALK: {
      const uint16_t pos = (uint16_t)(2 * (SAFE_W - ANIM_W));
      const uint16_t fr  = WALK_FRAME_COUNT;
      return (uint16_t)(pos / gcd16(pos, fr) * fr);
    }
    case AN_EYE:
    case AN_FIDGET:
    case AN_HEART: return anim_count(id);
    // NOT A PERIOD, A VIEWING LENGTH, see anim.h. Two blinks of the slowest of
    // the four eyes; the true common period is 419,543 frames.
    case AN_EYES:  return 74;
    default:       return anim_count(id);
  }
}

bool anim_cycle_exact(uint8_t id) { return id != AN_EYES; }

// Nothing is allowed a blank frame. See the note in anim.h, this predicate is
// the declaration the prover demands before it will accept one, and the reason
// it exists is that the heart got one by accident for months.
bool anim_blank_ok(uint8_t id) { (void)id; return false; }

static const uint8_t *frame_ptr(uint8_t id, uint8_t f) {
  switch (id) {
    case AN_WALK:   return walkFrames[f];
    case AN_EYE:    return eyeFrames[f];
    case AN_FIDGET: return fidgetFrames[f];
    case AN_HEART:  return heartFrames[f];
  }
  return walkFrames[0];
}

// The walker's travel, in pixels. He turns around at the safe margin rather
// than walking off the glass: ink outside the safe area is clipped once the
// anti-burn-in shift wanders, and on an animation that would read as a bug.
static const int16_t WALK_RANGE = SAFE_W - ANIM_W;      // 116 - 48 = 68

void anim_draw(GFXcanvas1 &c, uint8_t id, uint16_t tick) {
  if (id >= AN_COUNT) id = AN_WALK;

  // ---- the four bitmap animations ----------------------------------------
  if (id <= AN_HEART) {
    const uint8_t n = anim_count(id);
    const uint8_t f = (uint8_t)(tick % n);

    const int16_t y = SAFE_Y0 + (SAFE_H - ANIM_H) / 2;
    int16_t x;
    if (id == AN_WALK) {
      // Ping-pong, so he paces back and forth instead of teleporting to the
      // left edge every lap.
      int16_t p = (int16_t)(tick % (uint16_t)(2 * WALK_RANGE));
      x = SAFE_X0 + (p < WALK_RANGE ? p : (int16_t)(2 * WALK_RANGE - p));
    } else {
      x = SAFE_X0 + (SAFE_W - ANIM_W) / 2;
    }

    ELEM("anim");
    c.drawBitmap(x, y, frame_ptr(id, f), ANIM_W, ANIM_H, 1);
    return;
  }

  // ---- the procedural ones -------------------------------------------------
  // No modulo here: each one takes the raw tick and does its own arithmetic,
  // which is what lets their periods differ from anim_count() (the walker's
  // 952 is the same idea applied to a bitmap).
  switch (id) {
    case AN_EYES:    draw_eyes4  (c, tick); break;
    case AN_ORBIT:   draw_orbit  (c, tick); break;
    case AN_SWING:   draw_swing  (c, tick); break;
    case AN_BALL:    draw_ball   (c, tick); break;
    case AN_WAVE:    draw_wave   (c, tick); break;
    case AN_RIPPLE:  draw_ripple (c, tick); break;
    case AN_CUBE:    draw_cube   (c, tick); break;
    case AN_SPIRAL:  draw_spiral (c, tick); break;
    case AN_STARS:   draw_stars  (c, tick); break;
    case AN_METRO:   draw_metro  (c, tick); break;
    case AN_SAND:    draw_sand   (c, tick); break;
    case AN_LOAD:    draw_load   (c, tick); break;
    case AN_BREATHE: draw_breathe(c, tick); break;
    case AN_HELIX:   draw_helix  (c, tick); break;
    case AN_SNAKE:   draw_snake  (c, tick); break;
    case AN_RAIN:    draw_rain   (c, tick); break;
    case AN_BARS:    draw_bars   (c, tick); break;
    default:         break;
  }
}


// ===========================================================================
// SHOWREEL SCENE PIECES, see anim.h. The reel that sequences these lives in
// pages.cpp; everything here is a pure function of its arguments, and the
// blank map reads the SAME leg table the renderer walks, so the two cannot
// drift apart.
// ===========================================================================

// A 48x48 1-bit PROGMEM blit, clipped to the safe area, optionally mirrored.
// c.drawBitmap() clips to the CANVAS, which is 6 columns and rows too
// generous, and the whole bezel-cross illusion is the sprite sliding out
// through the safe-area edge, so every pixel goes through the same clip the
// procedural kit uses. hflip exists because the BR->BL leg walks left and the
// artwork only walks right; mirroring the bitmap is the whole of "turning
// around".
static void ablit48(GFXcanvas1 &c, const uint8_t *frame,
                    int16_t x0, int16_t y0, bool hflip) {
  for (int16_t r = 0; r < ANIM_H; r++) {
    const int16_t y = (int16_t)(y0 + r);
    if (y < SAFE_Y0 || y > SAFE_Y1) continue;
    const uint8_t *row = frame + (size_t)r * (ANIM_W / 8);
    for (int16_t col = 0; col < ANIM_W; col++) {
      if (!(pgm_read_byte(row + (col >> 3)) & (0x80 >> (col & 7)))) continue;
      const int16_t x = (int16_t)(x0 + (hflip ? (ANIM_W - 1 - col) : col));
      if (x < SAFE_X0 || x > SAFE_X1) continue;
      c.drawPixel(x, y, 1);
    }
  }
}

// ---- the walker's pass -----------------------------------------------------
// See anim.h for the rules of motion. The whole geometry is one sweep: on the
// panel he is crossing, the sprite cell's x runs -38..114 in 8 px steps (20
// ticks), which carries the ARTWORK from fully off one edge to fully off the
// other; between the two panels sits one hidden bezel beat. A right-to-left
// pass is the exact mirror, position mirrored about the safe area's centre,
// sprite mirrored by the blit, so both directions share one set of numbers.
static const int16_t SR_WY     = (int16_t)(SAFE_Y0 + (SAFE_H - ANIM_H) / 2); // 8
static_assert(SR_PASS_TICKS == 2 * SR_CROSS + 1,
              "a pass is two panel crossings and one bezel beat.");
// The mirror: cell x -> the x that puts the mirrored cell in the mirrored
// place. (SAFE_X0 + SAFE_X1 - (ANIM_W - 1)) = 80 with this build's safe area.
static const int16_t SR_MIRROR = (int16_t)(SAFE_X0 + SAFE_X1 - (ANIM_W - 1));

// Which panel carries the walker at tick t of the pass, and where. Returns
// 0xFF for the bezel beat.
static uint8_t sr_pass_at(uint16_t t, uint8_t variant, int16_t *x) {
  const bool bottom = (variant & 1) != 0;
  const bool rtl    = (variant & 2) != 0;
  uint8_t panel;              // 0 = the panel he enters, 1 = the other one
  if (t < SR_CROSS)            panel = 0;
  else if (t == SR_CROSS)      return 0xFF;
  else                         panel = 1;
  const uint16_t u = (uint16_t)(panel == 0 ? t : t - SR_CROSS - 1);
  int16_t cx = (int16_t)(SR_PASS_X0 + SR_SPEED * (int16_t)u);
  if (rtl) cx = (int16_t)(SR_MIRROR - cx);
  *x = cx;
  // Left-to-right enters the LEFT panel of the row; right-to-left the RIGHT.
  const uint8_t left  = bottom ? (uint8_t)SLOT_BL : (uint8_t)SLOT_TL;
  const uint8_t right = bottom ? (uint8_t)SLOT_BR : (uint8_t)SLOT_TR;
  if (!rtl) return panel == 0 ? left : right;
  return panel == 0 ? right : left;
}

void sr_pass_draw(GFXcanvas1 &c, uint8_t slot, uint16_t t, uint8_t variant) {
  if (t >= SR_PASS_TICKS) t = (uint16_t)(t % SR_PASS_TICKS);
  int16_t x;
  const uint8_t on = sr_pass_at(t, variant, &x);
  if (on != (uint8_t)(slot & 3)) return;
  ELEM("sr-walk");
  // WALKER_TEMPO artwork frames per tick, the gait-to-ground lock described
  // in anim.h: the pose and the position advance from the same counter, so
  // the planted foot stays planted at every tempo. The pose counter runs
  // over the whole pass and never resets while he is on the glass.
  ablit48(c, walkFrames[(uint16_t)(t * WALKER_TEMPO) % WALK_FRAME_COUNT],
          x, SR_WY, (variant & 2) != 0);
}

bool sr_pass_blank_ok(uint8_t slot, uint16_t t, uint8_t variant) {
  if (t >= SR_PASS_TICKS) t = (uint16_t)(t % SR_PASS_TICKS);
  int16_t x;
  const uint8_t on = sr_pass_at(t, variant, &x);
  if (on != (uint8_t)(slot & 3)) return true;
  // Ink is only PROMISED where the whole sprite cell is on this panel; a
  // clipped entry or exit strip may legitimately be empty artwork.
  return !(x >= SAFE_X0 && (int16_t)(x + ANIM_W - 1) <= SAFE_X1);
}

// ---- the heart -------------------------------------------------------------
static_assert(HEART_FRAME_COUNT == 27 && SR_HEART_TICKS == 27,
              "SR_HEART_TICKS is the heart's frame count; they moved apart.");
void sr_heart_draw(GFXcanvas1 &c, uint16_t t) {
  ELEM("sr-heart");
  ablit48(c, heartFrames[t % SR_HEART_TICKS],
          (int16_t)(SAFE_X0 + (SAFE_W - ANIM_W) / 2),
          (int16_t)(SAFE_Y0 + (SAFE_H - ANIM_H) / 2), false);
}

// ---- the weather drawings --------------------------------------------------
// All composed through the safe-area-clipped kit above, all confined to
// y[WX_BOX_Y0..WX_BOX_Y1] so the weather panel's text never has to negotiate
// with them. Centred on the panel's x middle.
static const int16_t WX_CX = (int16_t)((SAFE_X0 + SAFE_X1) / 2);      // 63
static const int16_t WX_CY = (int16_t)((WX_BOX_Y0 + WX_BOX_Y1) / 2); // 31

// A little cumulus: two stacked discs under a flat base line. `phase` nudges
// it horizontally for the drift.
static void wx_cloud(GFXcanvas1 &c, int16_t cx, int16_t cy, int16_t dxo) {
  ahline(c, (int16_t)(cx - 11 + dxo), (int16_t)(cx + 11 + dxo), (int16_t)(cy + 4));
  acircle(c, (int16_t)(cx - 6 + dxo), (int16_t)(cy + 1), 3);
  acircle(c, (int16_t)(cx + 1 + dxo), (int16_t)(cy - 2), 5);
  acircle(c, (int16_t)(cx + 7 + dxo), (int16_t)(cy + 1), 3);
}

// The sun: a disc whose rays TWINKLE, cardinal rays and diagonal rays
// alternate every 8 ticks, the classic 1-bit sparkle. Reach is disc r4 +
// gap 6 + len 3 = 9 px from centre, which is exactly what the box allows.
static void wx_sun(GFXcanvas1 &c, int16_t cx, int16_t cy, uint16_t tick) {
  adisc(c, cx, cy, 4);
  static const int8_t RX[8] = {1, 1, 0, -1, -1, -1, 0, 1};
  static const int8_t RY[8] = {0, 1, 1, 1, 0, -1, -1, -1};
  const uint8_t odd = (uint8_t)((tick >> 3) & 1);   // which four rays
  for (uint8_t i = odd; i < 8; i = (uint8_t)(i + 2)) {
    const int16_t x0 = (int16_t)(cx + RX[i] * 6);
    const int16_t y0 = (int16_t)(cy + RY[i] * 6);
    aline(c, x0, y0, (int16_t)(x0 + RX[i] * 3), (int16_t)(y0 + RY[i] * 3));
  }
}

void wx_anim_draw(GFXcanvas1 &c, uint8_t kind, uint16_t tick) {
  switch (kind) {
    default:
    case WX_SUNNY:
      ELEM("wx-sun");
      wx_sun(c, WX_CX, WX_CY, tick);
      break;
    case WX_PARTLY: {
      // The sun peeks over the cloud's shoulder; the cloud drifts +/-3 px on
      // a slow 32-tick triangle, which reads as a breeze rather than a slide.
      ELEM("wx-partly");
      const int16_t ph = (int16_t)(tick & 31);
      const int16_t drift = (int16_t)((ph < 16 ? ph : 31 - ph) * 6 / 15 - 3);
      adisc(c, (int16_t)(WX_CX + 8), (int16_t)(WX_BOX_Y0 + 5), 4);
      wx_cloud(c, (int16_t)(WX_CX - 2), (int16_t)(WX_CY + 3), drift);
      break;
    }
    case WX_RAIN: {
      // Drops fall from the cloud base to a catch line, three columns out of
      // phase so the fall reads as continuous at 8 fps.
      ELEM("wx-rain");
      wx_cloud(c, WX_CX, (int16_t)(WX_BOX_Y0 + 7), 0);          // rows 22..33
      const int16_t base = (int16_t)(WX_BOX_Y0 + 12);           // 34
      for (uint8_t i = 0; i < 3; i++) {
        const int16_t x = (int16_t)(WX_CX - 8 + i * 8);
        const int16_t fall = (int16_t)((tick * 2 + i * 3) % 7); // 34..41
        avline(c, x, (int16_t)(base + fall), (int16_t)(base + fall + 1));
      }
      ahline(c, (int16_t)(WX_CX - 11), (int16_t)(WX_CX + 11), WX_BOX_Y1);
      break;
    }
  }
}
